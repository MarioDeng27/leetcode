AUTOSAR XML (schema 00047)
package /Machine
  ethernet cluster EthernetCluster
    ethernet physical channel EthernetPhysicalChannel
      network endpoint SDMulticastEndpoint: network-endpoint-addresses=ipv-4-configuration=ipv-4-address=224.0.0.17
      network endpoint NetworkEndpoint: network-endpoint-addresses=ipv-4-configuration=ipv-4-address=192.168.7.2
  mode declaration group MachineStates: initial-mode=Running
    5 x mode:
      Running: value=0
      Startup: value=1
      Shutdown: value=2
      Restart: value=3
      Off: value=4
  machine design ClientMachineDesign: service-discover-configs=someip-service-discovery={multicast-sd-ip-address=SDMulticastEndpoint, someip-service-discovery-port=12330}
    ethernet communication connector NetworkConnector: unicast-network-endpoint=NetworkEndpoint
    ethernet communication connector SDMulticastConnector: unicast-network-endpoint=SDMulticastEndpoint
  machine design ServerMachineDesign: service-discover-configs=someip-service-discovery={multicast-sd-ip-address=SDMulticastEndpoint, someip-service-discovery-port=12330}
    ethernet communication connector NetworkConnector: unicast-network-endpoint=NetworkEndpoint
  machine ClientMachine: machine-design=ClientMachineDesign
    function-groups:
      mode declaration group prototype MachineState: type=MachineStates
    os module instantiation Os
      resource group ControlGroup: cpu-usage=50, mem-usage=1024
    processor Processor
      processor core Core0
  machine ServerMachine: machine-design=ServerMachineDesign
    function-groups:
      mode declaration group prototype MachineState: type=MachineStates
    os module instantiation Os
      resource group ControlGroup: cpu-usage=50, mem-usage=1024
    processor Processor
      processor core Core0
package /ServiceInterfaces
  service interface ServiceInterface
    namespaces:
      symbol props tongjiDemo
    events:
      data divisionByZero: type=uint32_t
    field divideResult: type=uint32_t, has-getter=true, has-notifier=true, has-setter=true
    methods:
      operation divide
        arg divident: type=uint32_t, direction=IN
        arg divisor: type=uint32_t, direction=IN
        arg result: type=uint32_t, direction=OUT
package /Applications
  adaptive application sw component type ClientSwComponentType
    require port RPort_ServiceInterface: required-interface=ServiceInterface
  adaptive application sw component type ServerSwComponentType
    provide port PPort_ServiceInterface: provided-interface=ServiceInterface
  executable Client
    root sw component prototype RootSwComponentPrototype: application-type=ClientSwComponentType
  executable Server
    root sw component prototype RootSwComponentPrototype: application-type=ServerSwComponentType
package /ApplicationsDeploy
  startup config set ClientStartupConfigSet
    startup config StartupConfig: scheduling-policy=SCHEDULING-POLICY-ROUND-ROBIN, scheduling-priority=30, startup-option{option-argument=./etc/application.json, option-kind=COMMAND-LINE-SHORT-FORM, option-name=c}
  process design ClientProcessDesign: executable=Client
  process ClientProcess: design=ClientProcessDesign, executable=Client, state-dependent-startup-config{function-group-state=MachineState.Running, startup-config=ClientStartupConfigSet/StartupConfig}
    process state machine ModeDeclarationGroupPrototype: type=MachineStates
  startup config set ServerStartupConfigSet
    startup config StartupConfig: scheduling-policy=SCHEDULING-POLICY-ROUND-ROBIN, scheduling-priority=31, startup-option{option-argument=./etc/application.json, option-kind=COMMAND-LINE-SHORT-FORM, option-name=c}
  process design ServerProcessDesign: executable=Server
  process ServerProcess: design=ServerProcessDesign, executable=Server, state-dependent-startup-config{function-group-state=MachineState.Running, startup-config=ServerStartupConfigSet/StartupConfig}
    process state machine ModeDeclarationGroupPrototype: type=MachineStates
package /ServiceInstances/ClientServiceInstance
  required someip service instance ServiceInterfaceDeploymentRequiredInstance: service-interface=ServiceInterfaceDeployment, required-minor-version=ANY, required-service-instance-id=1, sd-client-config=ServiceInterfaceDeploymentRequiredInstanceConfig
    someip required event group SomeipEventGroup: event-group=SomeipEventGroup, sd-client-event-group-timing-config=ServiceInterfaceDeploymentRequiredInstance_001
  service instance to port prototype mapping ServiceInterfaceDeploymentRequiredInstanceMapping: port-prototype=RootSwComponentPrototype.RPort_ServiceInterface, process=ClientProcess, service-instance=ServiceInterfaceDeploymentRequiredInstance
  someip sd client service instance config ServiceInterfaceDeploymentRequiredInstanceConfig: initial-find-behavior={initial-delay-max-value=0.1, initial-delay-min-value=0.01, initial-repetitions-base-delay=0.2, initial-repetitions-max=3}, service-find-time-to-live=3
  someip sd client event group timing config ServiceInterfaceDeploymentRequiredInstance_001: request-response-delay={max-value=2, min-value=1}, time-to-live=5
package /ServiceInstances/ServerServiceInstance
  provided someip service instance ServiceInterfaceDeploymentProvidedInstance: service-interface=ServiceInterfaceDeployment, sd-server-config=ServiceInterfaceDeploymentProvidedInstanceConfig, service-instance-id=1
    someip provided event group SomeipEventGroup: event-group=SomeipEventGroup, multicast-threshold=3
  service instance to port prototype mapping ServiceInterfaceDeploymentProvidedInstanceMapping: port-prototype=RootSwComponentPrototype.PPort_ServiceInterface, process=ServerProcess, service-instance=ServiceInterfaceDeploymentProvidedInstance
  someip sd server service instance config ServiceInterfaceDeploymentProvidedInstanceConfig: initial-offer-behavior={initial-delay-max-value=0.1, initial-delay-min-value=0.01, initial-repetitions-base-delay=0.2, initial-repetitions-max=3}, offer-cyclic-delay=2, request-response-delay={max-value=1.5, min-value=1.5}, service-offer-time-to-live=10
package /ServiceInstanceToMachineMappings
  someip service instance to machine mapping ServiceInterfaceDeploymentRequiredInstanceMachine: communication-connector=ClientMachineDesign/NetworkConnector, service-instance=ServiceInterfaceDeploymentRequiredInstance, tcp-port=30001
  someip service instance to machine mapping ServiceInterfaceDeploymentProvidedInstanceMachine: communication-connector=ServerMachineDesign/NetworkConnector, service-instance=ServiceInterfaceDeploymentProvidedInstance, tcp-port=30002
