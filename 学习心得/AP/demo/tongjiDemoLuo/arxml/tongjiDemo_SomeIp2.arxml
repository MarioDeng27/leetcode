AUTOSAR XML (schema 00047)
package /ServiceInterfaces/SomeIp
  someip service interface deployment ServiceInterfaceDeployment: service-interface=ServiceInterface, service-interface-id=100, service-interface-version={major-version=1, minor-version=0}
    someip event deployment divisionByZero: event=divisionByZero, event-id=1000, transport-protocol=TCP
    someip field deployment divideResult: field=divideResult
      get getDivideResult: method-id=2000, transport-protocol=TCP
      notifier onDivideResult: event-id=1001, transport-protocol=TCP
      set setDivideResult: method-id=2001, transport-protocol=TCP
    someip method deployment divide: method=divide, method-id=2002, transport-protocol=TCP
    someip event group SomeipEventGroup: event-group-id=200, event=[divisionByZero, onDivideResult]
