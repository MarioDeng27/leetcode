AUTOSAR XML (schema 00047)
package /ServiceInterfaces/Someip
  someip service interface deployment ServiceInterfaceDeployment: service-interface=ServiceInterface, service-interface-id=100, service-interface-version={major-version=1, minor-version=0}
    someip event deployment addInfo: event=addInfo, event-id=1000, transport-protocol=UDP
    someip field deployment addResult: field=addResult
      get getAddResult: method-id=2000, transport-protocol=UDP
      notifier onAddResult: event-id=1001, transport-protocol=UDP
      set setAddResult: method-id=2001, transport-protocol=UDP
    someip method deployment add: method=add, method-id=2002, transport-protocol=UDP
    someip event group SomeipEventGroup: event-group-id=200, event=[addInfo, onAddResult]
